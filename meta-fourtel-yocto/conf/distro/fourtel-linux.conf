## meta-fourtel-yocto/conf/distro/fourtel-linux.conf
```bitbake
require conf/distro/protobuf-version.conf

DISTRO = "fourtel-linux"
DISTRO_NAME = "Fourtel Linux"
DISTRO_VERSION = "1.0"
PREFERRED_VERSION_nodejs = "20.12.2"
PREFERRED_VERSION_icu = "71.1"
DISTRO_FEATURES:append = " systemd"
```

## meta-fourtel-yocto/conf/layer.conf
```bitbake
# We have a conf and classes directory, add to BBPATH
BBPATH .= ":${LAYERDIR}"

# We have recipes-* directories, add to BBFILES
BBFILES += "${LAYERDIR}/recipes-*/*/*.bb \
            ${LAYERDIR}/recipes-*/*/*.bbappend"

BBFILE_COLLECTIONS += "meta-fourtel-yocto"
BBFILE_PATTERN_meta-fourtel-yocto = "^${LAYERDIR}/"
BBFILE_PRIORITY_meta-fourtel-yocto = "6"

LAYERDEPENDS_meta-fourtel-yocto = "core"
LAYERSERIES_COMPAT_meta-fourtel-yocto = "kirkstone mickledore"


BBFILE_PRIORITY_meta-fourtel-yocto = "10"
```
